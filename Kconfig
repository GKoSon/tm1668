## Kconfig
```kconfig
config PKG_USING_TM1668
    bool "Enable TM1668 package"
    default n
    help
        Enable TM1668 package.

if PKG_USING_TM1668
    config TM1668_STB_PIN_NAME
        string "TM1668 STB pin name"
        default "PB.12"
        help
            Pin name for TM1668 STB (NianDong Board PB.12).

    config TM1668_CLK_PIN_NAME
        string "TM1668 CLK pin name"
        default "PE.12"
        help
            Pin name for TM1668 CLK (NianDong Board PE.12).

    config TM1668_DIO_PIN_NAME
        string "TM1668 DIO pin name"
        default "PB.10"
        help
            Pin name for TM1668 DIO (NianDong Board PB.10).

    config USING_TM1668_DEMO
        bool "Enable TM1668 Demo (example folder)"
        default n
        help
            Enable this option to compile the example code in the "example" folder.            
endif 
```
